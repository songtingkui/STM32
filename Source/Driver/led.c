/*********************************************************************************************************
* 模块名称：led.c
* 
* 摘    要：板载LED指示灯控制接口（PA2，低亮）
* 
* 当前版本：1.0.0
* 
* 作    者：ZLGCX(COPYRIGHT 2021 - 2030 ZLGCX. All rights reserved.)
* 
* 完成日期：2021年05月11日 
* 
* 内    容：1、接口初始化
*			2、亮灭控制
*			
* 注    意：                                                                 
**********************************************************************************************************
* 取代版本：
* 
* 作    者： 
* 
* 完成日期：
* 
* 修改内容：
* 
* 修改文件：
*********************************************************************************************************/


/*********************************************************************************************************
*                                              包含头文件
*********************************************************************************************************/
#include "hk32f030m.h"

#include "led.h"
#include "delay.h"

/*********************************************************************************************************
*                                              宏定义
*********************************************************************************************************/

/*********************************************************************************************************
*                                              枚举结构体定义
*********************************************************************************************************/

/*********************************************************************************************************
*                                              内部变量
*********************************************************************************************************/
uint32_t LedStep = 1;
uint32_t LedTick = 0;


/*********************************************************************************************************
*                                              全局变量
*********************************************************************************************************/

/*********************************************************************************************************
*                                              内部函数声明
*********************************************************************************************************/

/*********************************************************************************************************
*                                              内部函数实现
*********************************************************************************************************/
/*********************************************************************************************************
* 函数名称：
* 函数功能：
* 输入参数：
* 输出参数：
* 返 回 值：
* 创建日期：2018年01月01日
* 注    意：
* 修改记录：
*********************************************************************************************************/


/*********************************************************************************************************
*                                              API函数实现
*********************************************************************************************************/
/*********************************************************************************************************
* 函数名称：void Led_Init(void)
* 
* 函数功能：LED指示灯接口初始化
* 
* 输入参数：None
* 输出参数：None
* 返 回 值：None
* 
* 创建日期：2021年05月10日
* 
* 注    意：
* 修改记录：
*********************************************************************************************************/
void Led_Initialize(void)
{
	GPIO_InitTypeDef GPIO_InitStructure;

	// Clock
	RCC_AHBPeriphClockCmd(MAIN_LED_CLK, ENABLE);
	
	// GPIO
    GPIO_InitStructure.GPIO_Pin  = MAIN_LED_PIN;
    GPIO_InitStructure.GPIO_Mode = GPIO_Mode_OUT;
	GPIO_InitStructure.GPIO_Speed  = GPIO_Speed_10MHz;
	GPIO_InitStructure.GPIO_OType  = GPIO_OType_PP;
    GPIO_InitStructure.GPIO_PuPd   = GPIO_PuPd_NOPULL;
    GPIO_InitStructure.GPIO_Schmit = GPIO_Schmit_Disable;
    GPIO_Init(MAIN_LED_PORT, &GPIO_InitStructure);
	
	// 静态控制：灯亮
    GPIO_ResetBits(MAIN_LED_PORT, MAIN_LED_PIN);
}

/*********************************************************************************************************
* 函数名称：void Led_On(void)
* 
* 函数功能：LED指示灯亮
* 
* 输入参数：None
* 输出参数：None
* 返 回 值：None
* 
* 创建日期：2021年05月10日
* 
* 注    意：
* 修改记录：
*********************************************************************************************************/

/*********************************************************************************************************
* 函数名称：void Ledshow(GPIO_TypeDef* GPIOx, uint16_t GPIO_Pin)
* 
* 函数功能：LED指示灯闪烁
* 
* 输入参数：GPIO_TypeDef* GPIOx 端口ABCD
*			uint16_t GPIO_Pin	端口1-7
* 输出参数：None
* 返 回 值：None
* 
* 创建日期：2021年05月10日
* 
* 注    意：
* 修改记录：
*********************************************************************************************************/
void Ledshow(GPIO_TypeDef* GPIOx, uint16_t GPIO_Pin)
{
	//PC3	
	switch (LedStep)
		{
			case 1:
				// 1.亮
				GPIO_ResetBits(GPIOx, GPIO_Pin);
			
				LedTick = g_u32_1msTick;
				LedStep = 2;			
			break;
				
			case 2:
				// 2.等待		
				if ((uint32_t)(g_u32_1msTick - LedTick) >= 500 )
				{	
					LedStep = 3;
				}
				break;
			
			case 3:
				// 3.灭
				GPIO_SetBits(GPIOx, GPIO_Pin);
				LedTick = g_u32_1msTick;
				LedStep = 4;			
			
			break;
			
			case 4:
				// 4.等待
				if ((uint32_t)(g_u32_1msTick - LedTick) >= 500)
				{		
					LedStep = 1;
				}
			break;
		}		
}



/*********************************************************************************************************
* 函数名称：uint32_t Led_IsOn(void)
* 
* 函数功能：指示灯亮否？
* 
* 输入参数：None
* 输出参数：None
* 
* 返 回 值：0 - 灭，1 - 亮
* 
* 创建日期：2021年05月10日
* 
* 注    意：
* 修改记录：
*********************************************************************************************************/

