/*********************************************************************************************************
* 模块名称：eeprom.c
* 
* 摘    要：HK32F030M芯片内部EEPROM读写接口
* 
* 当前版本：1.0.0
* 
* 作    者：ZLGCX(COPYRIGHT 2021 - 2030 ZLGCX. All rights reserved.)
* 
* 完成日期：2021年05月11日 
* 
* 内    容：
*			
* 注    意：                                                                 
**********************************************************************************************************
* 取代版本：
* 
* 作    者： 
* 
* 完成日期：
* 
* 修改内容：
* 
* 修改文件：
*********************************************************************************************************/


/*********************************************************************************************************
*                                              包含头文件
*********************************************************************************************************/
#include "hk32f030m.h"

#include "eeprom.h"

/*********************************************************************************************************
*                                              宏定义
*********************************************************************************************************/
#define  HK32F030M_EE_BEGIN    (0x0C000000ul)             // HK32F030M芯片内部EEPROM开始地址
#define  HK32F030M_EE_END      (0x0C0001C0ul)             // HK32F030M芯片内部EEPROM结束地址
#define  HK32F030M_EE_SIZE     (448)                      // HK32F030M芯片内部EEPROM存储数量

/*********************************************************************************************************
*                                              枚举结构体定义
*********************************************************************************************************/

/*********************************************************************************************************
*                                              内部变量
*********************************************************************************************************/
 
/*********************************************************************************************************
*                                              内部函数声明
*********************************************************************************************************/

/*********************************************************************************************************
*                                              内部函数实现
*********************************************************************************************************/
/*********************************************************************************************************
* 函数名称：
* 函数功能：
* 输入参数：
* 输出参数：
* 返 回 值：
* 创建日期：2018年01月01日
* 注    意：
* 修改记录：
*********************************************************************************************************/


/*********************************************************************************************************
*                                              API函数实现
*********************************************************************************************************/
/*********************************************************************************************************
* 函数名称：uint8_t EEPROM_WriteByte(uint32_t address, uint8_t data_in)
* 
* 函数功能：根据指定的偏移地址将数据写入EEPROM
* 
* 输入参数：address = 要写入数据的目标地址, 是基于EEPROM起始地址的偏移量(0 <= address < HK32F030M_EE_SIZE)
*           data_in = 要写入的Byte数据
*           
* 输出参数：None
* 
* 返 回 值：0 = 写入失败；1 = 写入成功
* 
* 创建日期：2021年05月10日
* 
* 注    意：
* 修改记录：
*********************************************************************************************************/
uint8_t EEPROM_WriteByte(uint32_t address, uint8_t data_in)
{
	// 检测写入地址
	if (HK32F030M_EE_SIZE <= address)
	{
		return 0;
	}

	// 关闭总中断
	__disable_irq();   
	
	// 写操作：解锁-擦除-编程-加锁
	FLASH_Unlock();
	EEPROM_EraseByte(address + HK32F030M_EE_BEGIN);
	EEPROM_ProgramByte(address + HK32F030M_EE_BEGIN, data_in);
	FLASH_Lock();
	
    // 开启总中断
	__enable_irq();
	
	// 读出检验
	if ((*((uint8_t *)(address + HK32F030M_EE_BEGIN))) != data_in)
	{
		return 0;
	}

	return 1;
}

/*********************************************************************************************************
* 函数名称：uint8_t EEPROM_ReadByte(uint32_t address, uint8_t *data_out)
* 
* 函数功能：根据指定的偏移地址将数据从EEPROM读出
* 
* 输入参数：address  = 要写入数据的目标地址, 是基于EEPROM起始地址的偏移量(0 <= address < HK32F030M_EE_SIZE)
*           
* 输出参数：data_out = 接收读出数据的缓存变量指针
* 
* 返 回 值：0 = 读取失败；1 = 读取成功
* 
* 创建日期：2021年05月10日
* 
* 注    意：
* 修改记录：
*********************************************************************************************************/
uint8_t EEPROM_ReadByte(uint32_t address, uint8_t *data_out)
{
	// 检测读取地址
	if (HK32F030M_EE_SIZE <= address)
	{
		return 0;
	}
	
	// 读取
	*data_out = *((uint8_t *)(address + HK32F030M_EE_BEGIN));

	return 1;
}
